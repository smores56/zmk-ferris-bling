## config/boards/shields/sweep/Kconfig.defconfig
```kconfig
# Copyright (c) 2020 The ZMK Contributors
# SPDX-License-Identifier: MIT

if SHIELD_SWEEP_LEFT

config ZMK_KEYBOARD_NAME
	default "Sweep"

config ZMK_SPLIT_BLE_ROLE_CENTRAL
	default y

endif

if SHIELD_SWEEP_RIGHT

config ZMK_KEYBOARD_NAME
	default "Sweep_Right"

endif

if SHIELD_SWEEP_RIGHT || SHIELD_SWEEP_LEFT

config ZMK_SPLIT
	default y

endif
```

## config/west.yml
```yaml
manifest:
  remotes:
    - name: zmkfirmware
      url-base: https://github.com/petejohanson
  projects:
    - name: zmk
      remote: zmkfirmware
      revision: boards/ferris-02-bling-basics
      import: app/west.yml
  self:
    path: config
```
